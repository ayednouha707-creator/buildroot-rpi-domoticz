## configs/rpi_domoticz_defconfig
```kconfig
# Buildroot 2025 configuration for Raspberry Pi with Domoticz
BR2_arm=y
BR2_cortex_a53=y
BR2_ARM_FPU_NEON_VFPV4=y
BR2_TOOLCHAIN_EXTERNAL=y
BR2_TOOLCHAIN_EXTERNAL_PATH="/home/user/Development-tools/tools/arm-bcm2708/arm-linux-gnueabihf"
BR2_TOOLCHAIN_EXTERNAL_PREFIX="arm-linux-gnueabihf"
BR2_TOOLCHAIN_EXTERNAL_GCC_4_9=y
BR2_TOOLCHAIN_EXTERNAL_HEADERS_4_1=y
BR2_TOOLCHAIN_EXTERNAL_CXX=y
BR2_TOOLCHAIN_EXTERNAL_WCHAR=y
BR2_TOOLCHAIN_EXTERNAL_NPTL=y
BR2_TOOLCHAIN_EXTERNAL_DYNAMIC_LIB=y
BR2_TOOLCHAIN_EXTERNAL_GLIBC=y
BR2_PACKAGE_LUA=y
BR2_PACKAGE_LUA_5_3=y
BR2_PACKAGE_DOMOTICZ=y
BR2_TARGET_ROOTFS_EXT2=y
BR2_TARGET_ROOTFS_EXT2_4=y
BR2_TARGET_ROOTFS_EXT2_SIZE="200M"
BR2_TARGET_ROOTFS_TAR=y
```
